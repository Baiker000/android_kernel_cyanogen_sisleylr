/* Copyright (c) 2013, The Linux Foundation. All rights reserved.
 *
 * This program is free software; you can redistribute it and/or modify
 * it under the terms of the GNU General Public License version 2 and
 * only version 2 as published by the Free Software Foundation.
 *
 * This program is distributed in the hope that it will be useful,
 * but WITHOUT ANY WARRANTY; without even the implied warranty of
 * MERCHANTABILITY or FITNESS FOR A PARTICULAR PURPOSE.  See the
 * GNU General Public License for more details.
 */

/*---------------------------------------------------------------------------
 * This file is autogenerated file using gcdb parser. Please do not edit it.
 * Update input XML file to add a new entry or update variable in this file
 * VERSION = "1.0"
 *---------------------------------------------------------------------------*/
&mdss_mdp {
	dsi_otm1284_boe_720p_video: qcom,mdss_dsi_otm1284_boe_720p_video {
		qcom,mdss-dsi-panel-name = "otm1284 boe 720p video mode dsi panel";
		qcom,mdss-dsi-panel-controller = <&mdss_dsi0>;
		qcom,mdss-dsi-panel-type = "dsi_video_mode";
		qcom,mdss-dsi-panel-destination = "display_1";
		qcom,mdss-dsi-panel-framerate = <60>;
		qcom,mdss-dsi-virtual-channel-id = <0>;
		qcom,mdss-dsi-stream = <0>;
		qcom,mdss-dsi-panel-width = <720>;
		qcom,mdss-dsi-panel-height = <1280>;
		qcom,mdss-dsi-h-front-porch = <172>;
		qcom,mdss-dsi-h-back-porch = <172>;
		qcom,mdss-dsi-h-pulse-width = <16>;
		qcom,mdss-dsi-h-sync-skew = <0>;
		qcom,mdss-dsi-v-back-porch = <20>;
		qcom,mdss-dsi-v-front-porch = <20>;
		qcom,mdss-dsi-v-pulse-width = <2>;
		qcom,mdss-dsi-h-left-border = <0>;
		qcom,mdss-dsi-h-right-border = <0>;
		qcom,mdss-dsi-v-top-border = <0>;
		qcom,mdss-dsi-v-bottom-border = <0>;
		qcom,mdss-dsi-bpp = <24>;
		qcom,mdss-dsi-color-order = "rgb_swap_rgb";
		qcom,mdss-dsi-underflow-color = <0xff>;
		qcom,mdss-dsi-border-color = <0>;
		qcom,mdss-dsi-on-command = [29 01 00 00 00 00 02 00 00
29 01 00 00 00 00 04 FF 12 84 01
29 01 00 00 00 00 02 00 80
29 01 00 00 00 00 03 FF 12 84
29 01 00 00 00 00 02 00 91
29 01 00 00 00 00 02 B0 92
29 01 00 00 00 00 02 00 80
29 01 00 00 00 00 0A C0 00 64 00 0F 11 00 64 0F 11
29 01 00 00 00 00 02 00 90
29 01 00 00 00 00 07 C0 00 5C 00 01 00 04
29 01 00 00 00 00 02 00 A4
29 01 00 00 00 00 02 C0 00
29 01 00 00 00 00 02 00 B3
29 01 00 00 00 00 03 C0 00 55
29 01 00 00 00 00 02 00 81
29 01 00 00 00 00 02 C1 55
29 01 00 00 00 00 02 00 90
29 01 00 00 00 00 05 F5 02 11 02 15
29 01 00 00 00 00 02 00 90
29 01 00 00 00 00 02 C5 50
29 01 00 00 00 00 02 00 94
29 01 00 00 00 00 02 C5 66
29 01 00 00 00 00 02 00 B2
29 01 00 00 00 00 03 F5 00 00
29 01 00 00 00 00 02 00 B4
29 01 00 00 00 00 03 F5 00 00
29 01 00 00 00 00 02 00 B6
29 01 00 00 00 00 03 F5 00 00
29 01 00 00 00 00 02 00 B8
29 01 00 00 00 00 03 F5 00 00
29 01 00 00 00 00 02 00 94
29 01 00 00 00 00 03 F5 00 00
29 01 00 00 00 00 02 00 D2
29 01 00 00 00 00 03 F5 06 15
29 01 00 00 00 00 02 00 B4
29 01 00 00 00 00 02 C5 CC
29 01 00 00 00 00 02 00 A0
29 01 00 00 00 00 0F C4 05 10 06 02 05 15 10 05 10 07 02 05 15 10
29 01 00 00 00 00 02 00 B0
29 01 00 00 00 00 03 C4 00 00
29 01 00 00 00 00 02 00 91
29 01 00 00 00 00 03 C5 19 52
29 01 00 00 00 00 02 00 00
29 01 00 00 00 00 03 D8 BC BC
29 01 00 00 00 00 02 00 B3
29 01 00 00 00 00 02 C5 84
29 01 00 00 00 00 02 00 BB
29 01 00 00 00 00 02 C5 8A
29 01 00 00 00 00 02 00 82
29 01 00 00 00 00 02 C4 0A
29 01 00 00 00 00 02 00 B2
29 01 00 00 00 00 02 C5 40
29 01 00 00 00 00 02 00 81
29 01 00 00 00 00 03 C4 82 0A
29 01 00 00 00 00 02 00 C6
29 01 00 00 00 00 02 B0 03
29 01 00 00 00 00 02 00 C2
29 01 00 00 00 00 02 F5 40
29 01 00 00 00 00 02 00 C3
29 01 00 00 00 00 02 F5 85
29 01 00 00 00 00 02 00 00
29 01 00 00 00 00 15 E1 00 09 10 1B 27 36 38 68 59 78 8B 76 85 5D 55 47 35 20 10 00
29 01 00 00 00 00 02 00 00
29 01 00 00 00 00 15 E2 00 09 10 1B 27 36 38 68 59 78 8B 76 85 5D 55 47 35 20 10 00
29 01 00 00 00 00 02 00 80
29 01 00 00 00 00 0C CB 00 00 00 00 00 00 00 00 00 00 00
29 01 00 00 00 00 02 00 90
29 01 00 00 00 00 10 CB 00 00 00 00 00 00 00 00 00 00 00 00 00 00 00
29 01 00 00 00 00 02 00 A0
29 01 00 00 00 00 10 CB 00 00 00 00 00 00 00 00 00 00 00 00 00 00 00
29 01 00 00 00 00 02 00 B0
29 01 00 00 00 00 10 CB 00 00 00 00 00 00 00 00 00 00 00 00 00 00 00
29 01 00 00 00 00 02 00 C0
29 01 00 00 00 00 10 CB 05 05 05 05 05 05 00 00 00 00 00 00 00 00 00
29 01 00 00 00 00 02 00 D0
29 01 00 00 00 00 10 CB 00 00 00 00 00 05 05 05 05 05 05 05 05 00 00
29 01 00 00 00 00 02 00 E0
29 01 00 00 00 00 0F CB 00 00 00 00 00 00 00 00 00 00 00 00 05 05
29 01 00 00 00 00 02 00 F0
29 01 00 00 00 00 0C CB FF FF FF FF FF FF FF FF FF FF FF
29 01 00 00 00 00 02 00 80
29 01 00 00 00 00 10 CC 0A 0C 0E 10 02 04 00 00 00 00 00 00 00 00 00
29 01 00 00 00 00 02 00 90
29 01 00 00 00 00 10 CC 00 00 00 00 00 2E 2D 09 0B 0D 0F 01 03 00 00
29 01 00 00 00 00 02 00 A0
29 01 00 00 00 00 0F CC 00 00 00 00 00 00 00 00 00 00 00 00 2E 2D
29 01 00 00 00 00 02 00 B0
29 01 00 00 00 00 10 CC 0F 0D 0B 09 03 01 00 00 00 00 00 00 00 00 00
29 01 00 00 00 00 02 00 C0
29 01 00 00 00 00 10 CC 00 00 00 00 00 2D 2E 10 0E 0C 0A 04 02 00 00
29 01 00 00 00 00 02 00 D0
29 01 00 00 00 00 0F CC 00 00 00 00 00 00 00 00 00 00 00 00 2D 2E
29 01 00 00 00 00 02 00 80
29 01 00 00 00 00 0D CE 8D 03 00 8C 03 00 8B 03 00 8A 03 00
29 01 00 00 00 00 02 00 90
29 01 00 00 00 00 0F CE 00 00 00 00 00 00 00 00 00 00 00 00 00 00
29 01 00 00 00 00 02 00 A0
29 01 00 00 00 00 0F CE 38 0B 85 00 8D 00 00 38 0A 85 01 8D 00 00
29 01 00 00 00 00 02 00 B0
29 01 00 00 00 00 0F CE 38 09 85 02 8D 00 00 38 08 85 03 8D 00 00
29 01 00 00 00 00 02 00 C0
29 01 00 00 00 00 0F CE 38 07 85 04 8D 00 00 38 06 85 05 8D 00 00
29 01 00 00 00 00 02 00 D0
29 01 00 00 00 00 0F CE 38 05 85 06 8D 00 00 38 04 85 07 8D 00 00
29 01 00 00 00 00 02 00 80
29 01 00 00 00 00 0F CF 00 00 00 00 00 00 00 00 00 00 00 00 00 00
29 01 00 00 00 00 02 00 90
29 01 00 00 00 00 0F CF 00 00 00 00 00 00 00 00 00 00 00 00 00 00
29 01 00 00 00 00 02 00 A0
29 01 00 00 00 00 0F CF 00 00 00 00 00 00 00 00 00 00 00 00 00 00
29 01 00 00 00 00 02 00 B0
29 01 00 00 00 00 0F CF 00 00 00 00 00 00 00 00 00 00 00 00 00 00
29 01 00 00 00 00 02 00 C0
29 01 00 00 00 00 0C CF 01 01 20 20 00 00 01 01 00 00 00
29 01 00 00 00 00 02 00 B5
29 01 00 00 00 00 07 C5 33 F1 FF 33 F1 FF
29 01 00 00 00 00 02 00 F6
29 01 00 00 00 00 02 90 1A
29 01 00 00 00 00 02 00 b1
29 01 00 00 00 00 02 c6 05 //pwm 22K

29 01 00 00 00 00 02 00 A0
29 01 00 00 00 00 0D D6 01 00 01 00 01 53 01 A6 01 A6 01 A6
29 01 00 00 00 00 02 00 B0
29 01 00 00 00 00 0D D6 01 A6 01 A6 01 A6 01 A6 01 A6 01 A6
29 01 00 00 00 00 02 00 C0
29 01 00 00 00 00 0D D6 37 11 00 6F 11 6F 6F 11 6F 6F 11 6F
29 01 00 00 00 00 02 00 D0
29 01 00 00 00 00 07 D6 6F 11 6F 6F 11 6F
29 01 00 00 00 00 02 00 E0
29 01 00 00 00 00 0D D6 37 11 33 37 11 37 37 11 37 37 11 37
29 01 00 00 00 00 02 00 F0
29 01 00 00 00 00 07 D6 37 11 37 37 11 37
29 01 00 00 00 00 02 81 81

29 01 00 00 00 00 02 00 00
29 01 00 00 00 00 04 FF FF FF FF
29 01 00 00 00 00 02 00 00
29 01 00 00 00 00 02 35 00
29 01 00 00 00 00 02 00 00
29 01 00 00 00 00 03 80 80 50	
29 01 00 00 00 00 02 00 00
29 01 00 00 00 00 02 51 00
29 01 00 00 00 00 02 00 00
29 01 00 00 00 00 02 53 24
29 01 00 00 00 00 02 00 00
29 01 00 00 00 00 02 55 03
05 01 00 00 78 00 02 11 00
05 01 00 00 00 00 02 29 00];
		qcom,mdss-dsi-off-command = [05 01 00 00 32 00 02 28 00
					05 01 00 00 78 00 02 10 00];
		qcom,mdss-dsi-on-command-state = "dsi_lp_mode";
		qcom,mdss-dsi-off-command-state = "dsi_hs_mode";
		qcom,mdss-dsi-h-sync-pulse = <1>;
		qcom,mdss-dsi-traffic-mode = "burst_mode";
		qcom,mdss-dsi-lane-map = "lane_map_0123";
		qcom,mdss-dsi-bllp-eof-power-mode;
		qcom,mdss-dsi-bllp-power-mode;
		qcom,mdss-pan-physical-width-dimension = <63>;
		qcom,mdss-pan-physical-height-dimension = <111>;
		qcom,mdss-dsi-lane-0-state;
		qcom,mdss-dsi-lane-1-state;
		qcom,mdss-dsi-lane-2-state;
		qcom,mdss-dsi-lane-3-state;
		qcom,mdss-dsi-panel-timings = [8c 20 14 00 46 4A 1A 24 18 03 04 00];
		qcom,mdss-dsi-t-clk-post = <0x04>;
		qcom,mdss-dsi-t-clk-pre = <0x1c>;
		qcom,mdss-dsi-dma-trigger = "trigger_sw";
		qcom,mdss-dsi-mdp-trigger = "none";
		qcom,mdss-dsi-reset-sequence = <1 5>, <0 2>, <1 10>;
		qcom,mdss-dsi-lp11-init;
		qcom,cont-splash-enabled;
	};
};
