

&dsi_nt35521_boe_720_vid {

	lenovo,lcd-effect-custom-mode-command = [
		39 00 00 00 00 00 06 F0 55 AA 52 08 00
		39 00 00 00 00 00 02 55 83
		39 01 00 00 00 00 11 CC 00 10 87 00 00 00 00 00 00 00 00 00 00 00 00 05  //sat = 01 CONTRAST =00 sre =0 IE=1

		//L15
		 39 00 00 00 00 00 06 F0 55 AA 52 08 02

		//R(+) MCR cmd
		 39 00 00 00 00 00 11 B0 00 C3 00 D4 00 E2 00 E3 00 E8 00 FA 01 0A 01 2A
		 39 00 00 00 00 00 11 B1 01 42 01 6F 01 9A 01 DC 02 16 02 19 02 4D 02 8D
		 39 00 00 00 00 00 11 B2 02 B3 02 E8 03 0B 03 3A 03 5A 03 74 03 9B 03 9D
		 39 01 00 00 00 00 05 B3 03 AD 03 B6
		//G(+) MCR cmd
		 39 00 00 00 00 00 11 B4 00 9E 00 BC 00 C2 00 CC 00 D6 00 EC 00 FC 01 19
		 39 00 00 00 00 00 11 B5 01 36 01 68 01 8F 01 D6 02 0E 02 0F 02 49 02 89
		 39 00 00 00 00 00 11 B6 02 AF 02 E5 03 0A 03 3B 03 5D 03 7B 03 A0 03 C8
		 39 00 00 00 00 00 05 B7 03 FA 03 FD
		//B(+) MCR cmd
		 39 00 00 00 00 00 11 B8 00 02 00 03 00 21 00 37 00 4E 00 6F 00 8E 00 CC
		 39 00 00 00 00 00 11 B9 00 F7 01 34 01 69 01 B8 01 FC 01 FE 02 3A 02 7D
		 39 00 00 00 00 00 11 BA 02 A4 02 D9 03 00 03 38 03 6C 03 FA 03 FB 03 FE
		 39 01 00 00 00 00 05 BB 03 FE 03 FE];
	lenovo,lcd-effect-custom-mode-command-state = "dsi_lp_mode";

	lenovo,lcd-effect-default-mode-command = [
		39 00 00 00 00 00 06 F0 55 AA 52 08 00
		39 00 00 00 00 00 02 55 83
		39 01 00 00 00 00 11 CC 41 16 87 00 00 00 00 00 00 00 00 00 00 00 00 05//sat = 01 CONTRAST =00 sre =0 IE=1
		 
		39 00 00 00 00 00 06 F0 55 AA 52 08 02

		//color temp = L12
		//R(+) MCR cmd
		39 00 00 00 00 00 11 B0 00 25 00 35 00 44 00 54 00 6B 00 8C 00 B2 00 EE
		39 00 00 00 00 00 11 B1 01 09 01 46 01 74 01 C5 02 07 02 08 02 42 02 85
		39 00 00 00 00 00 11 B2 02 AA 02 DE 03 02 03 31 03 4D 03 64 03 90 03 91
		39 01 00 00 00 00 05 B3 03 A9 03 B6
		//G(+) MCR cmd
		39 00 00 00 00 00 11 B4 00 A1 00 A2 00 C5 00 D5 00 E0 00 F0 01 01 01 1C
		39 00 00 00 00 00 11 B5 01 38 01 69 01 91 01 D7 02 0E 02 10 02 49 02 89
		39 00 00 00 00 00 11 B6 02 AF 02 E5 03 0B 03 3C 03 5F 03 7B 03 A0 03 E9
		39 00 00 00 00 00 05 B7 03 FA 03 FD
		//B(+) MCR cmd
		39 00 00 00 00 00 11 B8 00 02 00 03 00 1C 00 37 00 4E 00 6F 00 8C 00 CC
		39 00 00 00 00 00 11 B9 00 F7 01 33 01 69 01 B8 01 F9 01 FF 02 3A 02 7D
		39 00 00 00 00 00 11 BA 02 A4 02 D9 03 00 03 39 03 6F 03 FA 03 FB 03 FC
		39 01 00 00 00 00 05 BB 03 FD 03 FE];
	lenovo,lcd-effect-default-mode-command-state = "dsi_lp_mode";


	lenovo,lcd-effect-comfort-mode-command = [
		39 00 00 00 00 00 06 F0 55 AA 52 08 00
		39 00 00 00 00 00 02 55 83
		39 01 00 00 00 00 11 CC 41 16 87 00 00 00 00 00 00 00 00 00 00 00 00 05//sat = 01 CONTRAST =00 sre =0 IE=1
		 
		39 00 00 00 00 00 06 F0 55 AA 52 08 02

		//color temp = L0
		//R(+) MCR cmd
		39 00 00 00 00 00 11 B0 01 4A 01 4F 01 53 01 58 01 5B 01 68 01 6E 01 81
		39 00 00 00 00 00 11 B1 01 93 01 B4 01 CF 01 FF 02 2E 02 30 02 5D 02 8E
		39 00 00 00 00 00 11 B2 02 AA 02 C8 02 D4 02 DF 02 E3 02 E5 02 E6 02 E7
		39 01 00 00 00 00 05 B3 02 E8 02 E9
		//G(+) MCR cmd
		39 00 00 00 00 00 11 B4 01 9A 01 9B 01 9F 01 A2 01 A6 01 AC 01 B3 01 BF
		39 00 00 00 00 00 11 B5 01 CA 01 E1 01 F6 02 1F 02 47 02 48 02 74 02 A5
		39 00 00 00 00 00 11 B6 02 C1 02 DF 02 ED 02 F8 02 FC 02 FF 03 00 03 01
		39 00 00 00 00 00 05 B7 03 02 03 03
		//B(+) MCR cmd
		39 00 00 00 00 00 11 B8 01 B4 01 B6 01 B8 01 BB 01 BE 01 C4 01 C9 01 D5
		39 00 00 00 00 00 11 B9 01 DF 01 F3 02 07 02 2C 02 52 02 53 02 7C 02 AD
		39 00 00 00 00 00 11 BA 02 CA 02 EB 02 FA 03 07 03 0B 03 0E 03 0F 03 10
		39 01 00 00 00 00 05 BB 03 12 03 13];
	lenovo,lcd-effect-comfort-mode-command-state = "dsi_lp_mode";



	lenovo,lcd-effect-outside-mode-command = [
		39 00 00 00 00 00 06 F0 55 AA 52 08 00
		39 00 00 00 00 00 02 55 43
		39 01 00 00 00 00 11 CC 41 16 87 00 00 00 00 00 00 00 00 00 00 50 FA 05//sat = 01 CONTRAST =00 sre =1 IE=1
		 
		39 00 00 00 00 00 06 F0 55 AA 52 08 02

		//color temp = L12
		//R(+) MCR cmd
		39 00 00 00 00 00 11 B0 00 25 00 35 00 44 00 54 00 6B 00 8C 00 B2 00 EE
		39 00 00 00 00 00 11 B1 01 09 01 46 01 74 01 C5 02 07 02 08 02 42 02 85
		39 00 00 00 00 00 11 B2 02 AA 02 DE 03 02 03 31 03 4D 03 64 03 90 03 91
		39 01 00 00 00 00 05 B3 03 A9 03 B6
		//G(+) MCR cmd
		39 00 00 00 00 00 11 B4 00 A1 00 A2 00 C5 00 D5 00 E0 00 F0 01 01 01 1C
		39 00 00 00 00 00 11 B5 01 38 01 69 01 91 01 D7 02 0E 02 10 02 49 02 89
		39 00 00 00 00 00 11 B6 02 AF 02 E5 03 0B 03 3C 03 5F 03 7B 03 A0 03 E9
		39 00 00 00 00 00 05 B7 03 FA 03 FD
		//B(+) MCR cmd
		39 00 00 00 00 00 11 B8 00 02 00 03 00 1C 00 37 00 4E 00 6F 00 8C 00 CC
		39 00 00 00 00 00 11 B9 00 F7 01 33 01 69 01 B8 01 F9 01 FF 02 3A 02 7D
		39 00 00 00 00 00 11 BA 02 A4 02 D9 03 00 03 39 03 6F 03 FA 03 FB 03 FC
		39 01 00 00 00 00 05 BB 03 FD 03 FE];
	lenovo,lcd-effect-outside-mode-command-state = "dsi_lp_mode";

	lenovo,lcd-effect-ultra-mode-command = [
		39 00 00 00 00 00 06 F0 55 AA 52 08 00
		39 00 00 00 00 00 02 55 83
		39 01 00 00 00 00 11 CC 41 16 87 00 00 00 00 00 00 00 00 00 00 00 00 05//sat = 01 CONTRAST =00 sre =0 IE=1
		 
		39 00 00 00 00 00 06 F0 55 AA 52 08 02

		//color temp = L12
		//R(+) MCR cmd
		39 00 00 00 00 00 11 B0 00 25 00 35 00 44 00 54 00 6B 00 8C 00 B2 00 EE
		39 00 00 00 00 00 11 B1 01 09 01 46 01 74 01 C5 02 07 02 08 02 42 02 85
		39 00 00 00 00 00 11 B2 02 AA 02 DE 03 02 03 31 03 4D 03 64 03 90 03 91
		39 01 00 00 00 00 05 B3 03 A9 03 B6
		//G(+) MCR cmd
		39 00 00 00 00 00 11 B4 00 A1 00 A2 00 C5 00 D5 00 E0 00 F0 01 01 01 1C
		39 00 00 00 00 00 11 B5 01 38 01 69 01 91 01 D7 02 0E 02 10 02 49 02 89
		39 00 00 00 00 00 11 B6 02 AF 02 E5 03 0B 03 3C 03 5F 03 7B 03 A0 03 E9
		39 00 00 00 00 00 05 B7 03 FA 03 FD
		//B(+) MCR cmd
		39 00 00 00 00 00 11 B8 00 02 00 03 00 1C 00 37 00 4E 00 6F 00 8C 00 CC
		39 00 00 00 00 00 11 B9 00 F7 01 33 01 69 01 B8 01 F9 01 FF 02 3A 02 7D
		39 00 00 00 00 00 11 BA 02 A4 02 D9 03 00 03 39 03 6F 03 FA 03 FB 03 FC
		39 01 00 00 00 00 05 BB 03 FD 03 FE];
	lenovo,lcd-effect-ultra-mode-command-state = "dsi_lp_mode";

	lenovo,lcd-effect-camera-mode-command = [
		39 00 00 00 00 00 02 55 00
		39 00 00 00 00 00 06 F0 55 AA 52 08 02
		
		//color temp = L12
		//R(+) MCR cmd
		39 00 00 00 00 00 11 B0 00 25 00 35 00 44 00 54 00 6B 00 8C 00 B2 00 EE
		39 00 00 00 00 00 11 B1 01 09 01 46 01 74 01 C5 02 07 02 08 02 42 02 85
		39 00 00 00 00 00 11 B2 02 AA 02 DE 03 02 03 31 03 4D 03 64 03 90 03 91
		39 01 00 00 00 00 05 B3 03 A9 03 B6
		//G(+) MCR cmd
		39 00 00 00 00 00 11 B4 00 A1 00 A2 00 C5 00 D5 00 E0 00 F0 01 01 01 1C
		39 00 00 00 00 00 11 B5 01 38 01 69 01 91 01 D7 02 0E 02 10 02 49 02 89
		39 00 00 00 00 00 11 B6 02 AF 02 E5 03 0B 03 3C 03 5F 03 7B 03 A0 03 E9
		39 00 00 00 00 00 05 B7 03 FA 03 FD
		//B(+) MCR cmd
		39 00 00 00 00 00 11 B8 00 02 00 03 00 1C 00 37 00 4E 00 6F 00 8C 00 CC
		39 00 00 00 00 00 11 B9 00 F7 01 33 01 69 01 B8 01 F9 01 FF 02 3A 02 7D
		39 00 00 00 00 00 11 BA 02 A4 02 D9 03 00 03 39 03 6F 03 FA 03 FB 03 FC
		39 01 00 00 00 00 05 BB 03 FD 03 FE];
	lenovo,lcd-effect-camera-mode-command-state = "dsi_lp_mode";

};

