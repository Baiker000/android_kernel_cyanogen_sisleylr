
&dsi_hx8394d_tianma_720p_video {

	lenovo,lcd-effect-gamma-command = [
		
//L0 6320
39 00 00 00 00 00 02 BD 00 
39 00 00 00 00 00 2C C1 01 08 10 16 1B 23 29 30 37 3E 46 4E 57 5F 67 6F 77 7F 87 8E 97 9F A7 AF B7 BE C7 CE D6 DE E6 EE F6 FF 07 70 F8 26 C8 05 09 60 C0
39 00 00 00 00 00 02 BD 01 
39 00 00 00 00 00 2B C1 05 0B 13 18 1F 25 2B 31 37 3F 46 4D 55 5C 63 6A 72 79 80 87 8E 95 9D A3 AB B2 B9 BF C7 CD D4 DB E0 03 6C D6 1F 14 52 22 30 C0 
39 00 00 00 00 00 02 BD 02 
39 01 00 00 00 00 2B C1 00 00 0C 15 1B 22 28 2E 33 3A 41 48 50 57 5E 65 6C 73 7A 81 87 8E 95 9C A2 AA B1 B7 BE C5 CB D1 D6 07 18 3F 00 08 09 01 0A 00 


//L1 6570
39 00 00 00 00 00 02 BD 00 
39 00 00 00 00 00 2C C1 01 08 10 16 1B 23 29 30 37 3E 46 4E 57 5F 67 6F 77 7F 87 8E 97 9F A7 AF B7 BE C7 CE D6 DE E6 EE F6 FA 07 70 F8 26 C8 05 09 60 C0
39 00 00 00 00 00 02 BD 01 
39 00 00 00 00 00 2B C1 05 0B 13 18 1F 25 2B 31 37 3F 46 4D 55 5C 63 6A 72 79 80 87 8E 95 9D A3 AB B2 B9 BF C7 CD D4 DB E2 03 6C D6 1F 14 52 22 30 C0 
39 00 00 00 00 00 02 BD 02 
39 01 00 00 00 00 2B C1 00 00 0C 15 1B 22 28 2E 33 3A 41 48 50 57 5E 65 6C 73 7A 81 87 8E 95 9C A2 AA B1 B7 BE C5 CB D1 DC 07 18 3F 00 08 09 01 0A 00 

//L2 6820	
39 00 00 00 00 00 02 BD 00 
39 00 00 00 00 00 2C C1 01 00 05 15 1A 21 27 2D 33 39 40 4A 52 59 61 69 71 79 80 87 8E 96 9E A5 AE B5 BC C4 CC D2 DA E2 EB F8 01 29 38 E8 1A BC 9A 92 C0
39 00 00 00 00 00 02 BD 01 
39 00 00 00 00 00 2B C1 00 08 13 19 1F 26 2C 32 3A 41 48 50 57 5F 66 6E 75 7C 84 8A 91 9A A0 A8 AF B6 BD C4 CC D2 D9 E2 E8 09 D8 28 44 B2 C8 FB AA C0 
39 00 00 00 00 00 02 BD 02 
39 01 00 00 00 00 2B C1 00 00 0E 16 1C 23 2A 30 34 3B 45 4C 53 5B 62 6A 71 79 80 86 8D 96 9C A3 AB B2 B9 BF C7 CD D4 DC DF 02 B0 3A ED 86 8A 13 30 00 
 
 //L3 7070	
39 00 00 00 00 00 02 BD 00 
39 00 00 00 00 00 2C C1 01 00 05 15 1A 21 27 2D 33 39 40 4A 52 59 61 69 71 79 80 87 8E 96 9E A5 AE B5 BC C4 CC D2 DA E2 EB F0 01 29 38 E8 1A BC 9A 92 C0
39 00 00 00 00 00 02 BD 01 
39 00 00 00 00 00 2B C1 00 08 13 19 1F 26 2C 32 3A 41 48 50 57 5F 66 6E 75 7C 84 8A 91 9A A0 A8 AF B6 BD C4 CC D2 D9 E2 E7 09 D8 28 44 B2 C8 FB AA C0 
39 00 00 00 00 00 02 BD 02 
39 01 00 00 00 00 2B C1 00 00 0E 16 1C 23 2A 30 34 3B 45 4C 53 5B 62 6A 71 79 80 86 8D 96 9C A3 AB B2 B9 BF C7 CD D4 DC E0 02 B0 3A ED 86 8A 13 30 00

//L4 7320
39 00 00 00 00 00 02 BD 00 
39 00 00 00 00 00 2C C1 01 09 13 15 1A 21 28 2E 34 3C 44 4B 53 5B 63 6B 72 7B 82 89 91 99 A1 A9 B1 B8 C0 C8 D0 D7 DE E7 EE F2 0E E3 55 03 6A E8 48 00 C0
39 00 00 00 00 00 02 BD 01 
39 00 00 00 00 00 2B C1 00 09 13 19 20 26 2C 32 39 41 48 50 57 5E 66 6D 76 7D 84 8B 93 9A A1 A9 B2 B8 BE C6 CE D5 DB E3 EA 30 3A A0 77 1D 36 1E 08 C0 
39 00 00 00 00 00 02 BD 02 
39 01 00 00 00 00 2B C1 00 00 10 18 1F 26 2C 33 3A 42 49 52 5A 62 6A 72 7A 82 89 91 98 A1 A9 B2 B9 C0 C8 CF D6 DE E5 EC E7 04 28 BC 00 8C C0 81 88 00

//L5 7570	
39 00 00 00 00 00 02 BD 00 
39 00 00 00 00 00 2C C1 01 09 13 15 1A 21 28 2E 34 3C 44 4B 53 5B 63 6B 72 7B 82 89 91 99 A1 A9 B1 B8 C0 C8 D0 D7 DE E7 EE F6 0E E3 55 03 6A E8 48 00 80
39 00 00 00 00 00 02 BD 01 
39 00 00 00 00 00 2B C1 00 09 13 19 20 26 2C 32 39 41 48 50 57 5E 66 6D 76 7D 84 8B 93 9A A1 A9 B2 B8 BE C6 CE D5 DB E3 EA 30 3A A0 77 1D 36 1E 08 C0 
39 00 00 00 00 00 02 BD 02 
39 01 00 00 00 00 2B C1 00 00 10 18 1F 26 2C 33 3A 42 49 52 5A 62 6A 72 7A 82 89 91 98 A1 A9 B2 B9 C0 C8 CF D6 DE E5 EC EE 04 28 BC 00 8C C0 81 88 00

//L6 7860
39 00 00 00 00 00 02 BD 00 
39 00 00 00 00 00 2C C1 01 09 13 15 1A 21 28 2E 34 3C 44 4B 53 5B 63 6B 72 7B 82 89 91 99 A1 A9 B1 B8 C0 C8 D0 D7 DE E7 EE F6 0E E3 55 03 6A E8 48 00 C0
39 00 00 00 00 00 02 BD 01 
39 00 00 00 00 00 2B C1 00 09 13 19 20 26 2C 32 39 41 48 50 57 5E 66 6D 76 7D 84 8B 93 9A A1 A9 B2 B8 BE C6 CE D5 DB E3 Ea 30 3A A0 77 1D 36 1E 08 C0 
39 00 00 00 00 00 02 BD 02 
39 01 00 00 00 00 2B C1 00 00 10 18 1F 26 2C 33 3A 42 49 52 5A 62 6A 72 7A 82 89 91 98 A1 A9 B2 B9 C0 C8 CF D6 DE E5 EC F3 04 28 BC 00 8C C0 81 88 00 

//L7 8120	
39 00 00 00 00 00 02 BD 00 
39 00 00 00 00 00 2C C1 01 09 11 16 1A 22 28 2F 35 3D 44 4C 54 5D 64 6D 75 7C 83 8B 93 9B A3 AA B2 BA C1 CA D2 DA E2 E8 F0 F9 13 20 37 20 FC CF 30 00 C0
39 00 00 00 00 00 02 BD 01 
39 00 00 00 00 00 2B C1 00 0A 13 19 20 26 2C 31 39 41 48 50 57 5F 67 6E 76 7D 84 8B 92 9A A1 A9 B0 B8 BE C6 CD D4 DB E3 E9 09 28 94 D1 16 BC CD 80 C0 
39 00 00 00 00 00 02 BD 02 
39 01 00 00 00 00 2B C1 00 00 10 18 1F 26 2D 33 3C 44 4B 54 5C 64 6D 73 7D 84 8C 94 9C A4 AC B4 BA C3 CB D2 D9 E1 E8 EF F8 0E FE 09 A0 10 00 C5 00 00 

//L8 8320	
39 00 00 00 00 00 02 BD 00 
39 00 00 00 00 00 2C C1 01 00 10 15 19 20 27 2E 34 3C 43 4B 53 5C 65 6C 75 7D 84 8C 95 9C A5 AC B5 BC C3 CA D2 D5 DF E8 EA F6 01 A4 00 00 00 00 00 00 C0
39 00 00 00 00 00 02 BD 01 
39 00 00 00 00 00 2B C1 00 0B 13 18 1F 26 2D 32 3A 42 49 51 59 61 69 71 79 80 88 8F 97 9F A6 AE B6 BD C5 CD D4 DA DE E6 E8 02 00 00 00 00 00 00 00 C0 
39 00 00 00 00 00 02 BD 02 
39 01 00 00 00 00 2B C1 01 00 10 15 19 20 27 2E 34 3C 43 4B 53 5C 65 6C 75 7D 84 8C 95 9C A5 AC B5 BC C3 CA D2 D5 DF E8 FA F3 01 A4 00 00 00 00 00 00 

//L9 8820	
39 00 00 00 00 00 02 BD 00 
39 00 00 00 00 00 2C C1 01 00 10 14 1B 21 28 2E 33 3C 44 4B 53 5A 62 6A 71 79 81 88 8F 98 9F A7 AF B6 BE C6 CD D4 DB E3 EB F0 0C AB 00 EA 9A 60 B1 A9 C0
39 00 00 00 00 00 02 BD 01 
39 00 00 00 00 00 2B C1 02 0C 13 19 20 26 2C 32 3A 41 48 50 57 5F 66 6E 75 7D 84 8B 92 9A 9F A7 AF B6 BE C6 CD D4 DB E3 E8 02 3C 38 84 C0 F0 20 B1 80 
39 00 00 00 00 00 02 BD 02 
39 01 00 00 00 00 2B C1 00 04 10 19 20 28 2E 35 3E 46 4D 56 5E 66 6E 76 7E 85 8D 95 9E A6 AE B6 BD C5 CE D4 DC E4 EA F2 FA 08 96 08 6A 7A BE A2 2C C0 

//L10 9070
39 00 00 00 00 00 02 BD 00 
39 00 00 00 00 00 2C C1 01 00 09 15 1A 20 26 2C 32 3A 40 49 50 58 60 68 70 77 7E 86 8D 95 9D A4 AB B4 BB C3 CB D1 D8 DF E7 Eb 0C 00 03 08 00 02 00 18 80
39 00 00 00 00 00 02 BD 01 
39 00 00 00 00 00 2B C1 02 0B 13 18 1F 25 2B 31 38 3E 47 4E 55 5D 65 6C 74 7B 82 88 90 98 9F A6 AD B5 BC C3 CB D1 D7 DE E6 02 22 20 EB 22 03 C0 5B 80 
39 00 00 00 00 00 02 BD 02 
39 01 00 00 00 00 2B C1 00 05 11 18 1F 26 2D 34 3C 43 4D 55 5D 66 6F 77 7E 86 8D 94 9D A6 AE B7 BD C5 CD D4 DC E4 EC F3 F9 08 28 A4 8B C9 90 E9 50 40

//L11 9320
39 00 00 00 00 00 02 BD 00 
39 00 00 00 00 00 2C C1 01 03 06 0D 17 1D 24 2B 32 39 41 48 4F 56 5D 64 6A 72 78 7F 86 8D 93 9A A1 A8 B0 B6 BC C4 CC D3 DB E9 00 6E 73 86 44 E9 03 15 00
39 00 00 00 00 00 02 BD 01 
39 00 00 00 00 00 2B C1 02 08 0F 17 1F 26 2D 34 3C 43 4A 51 59 60 68 6F 75 7C 84 8B 92 99 A0 A7 AF B6 BD C4 CA D1 D9 DF E6 48 64 D2 19 2F 61 00 99 00 
39 00 00 00 00 00 02 BD 02 
39 01 00 00 00 00 2B C1 09 0D 0F 18 22 2A 31 38 3F 47 50 57 5F 67 6E 76 7E 85 8D 95 9D A5 AD B5 BF C7 CF D9 DE E9 EF F6 FA 00 90 D4 24 8F E3 02 79 00

//L12 9570
39 00 00 00 00 00 02 BD 00 
39 00 00 00 00 00 2C C1 01 03 06 0D 17 1E 25 2C 32 3A 42 49 50 57 5E 65 6C 73 79 80 88 8F 95 9C A3 AA B2 B8 BF C7 CF D5 E0 E6 60 C1 22 4B 68 B4 02 A4 00
39 00 00 00 00 00 02 BD 01 
39 00 00 00 00 00 2B C1 02 08 0F 17 1E 26 2C 34 3B 43 4A 51 58 60 67 6E 75 7C 83 8A 91 99 A0 A6 AE B5 BD C3 CA D0 D8 DE E5 04 13 8D 80 45 B7 01 AE 00 
39 00 00 00 00 00 02 BD 02 
39 01 00 00 00 00 2B C1 09 0D 11 1A 23 2A 32 38 40 48 51 58 60 68 6F 78 7F 87 8F 97 9E A7 AE B8 C1 C9 D2 DB DF EB F1 F7 FB 00 28 43 20 13 0C 01 F5 00 
 
//L13 9820
39 00 00 00 00 00 02 BD 00 
39 00 00 00 00 00 2C C1 01 03 06 0D 17 1E 25 2C 32 3A 42 49 50 57 5E 65 6C 73 79 80 88 8F 95 9C A3 AA B2 B8 BF C7 CF D5 E0 E6 60 C1 22 4B 68 B4 02 A4 00
39 00 00 00 00 00 02 BD 01 
39 00 00 00 00 00 2B C1 02 08 0F 17 1E 26 2C 34 3B 43 4A 51 58 60 67 6E 75 7C 83 8A 91 99 A0 A6 AE B5 BD C3 CA D0 D8 DE E5 04 13 8D 80 45 B7 01 AE 00 
39 00 00 00 00 00 02 BD 02 
39 01 00 00 00 00 2B C1 09 0D 11 1A 23 2A 32 38 40 48 51 58 60 68 6F 78 7F 87 8F 97 9E A7 AE B8 C1 C9 D2 DB DF EB F1 F7 FC 00 28 43 20 13 0C 01 F5 80 

//L14 10070	
39 00 00 00 00 00 02 BD 00 
39 00 00 00 00 00 2C C1 01 03 06 0D 17 1D 24 2B 32 39 41 48 4F 56 5D 64 6A 72 78 7F 86 8D 93 9A A1 A8 B0 B6 BC C4 CC D3 DB E3 00 6E 73 86 44 E9 03 15 00
39 00 00 00 00 00 02 BD 01 
39 00 00 00 00 00 2B C1 02 08 0F 17 1E 26 2C 34 3B 42 49 51 58 5F 67 6E 75 7B 82 8A 90 98 9F A6 AD B4 BC C2 C9 D0 D7 DD E4 34 CF 24 6E EF DC 02 B3 00 
39 00 00 00 00 00 02 BD 02 
39 01 00 00 00 00 2B C1 09 0D 11 1A 23 2B 32 39 41 49 51 59 61 69 70 79 80 88 90 98 A0 A9 B0 BA C2 CB D4 DE E1 EC F3 F8 FC 00 70 3D 23 64 19 02 FC 00

//L15 10070
39 00 00 00 00 00 02 BD 00 
39 00 00 00 00 00 2C C1 01 03 06 0D 16 1D 24 2A 31 38 40 47 4E 55 5C 62 68 70 76 7D 84 8B 91 98 A0 A5 AD B4 BA C1 C9 D1 D6 E1 40 70 23 D0 19 0D 02 D2 00
39 00 00 00 00 00 02 BD 01 
39 00 00 00 00 00 2B C1 02 07 0F 17 1E 26 2C 34 3B 42 49 50 57 5F 66 6D 74 7B 82 89 8F 97 9E A5 AC B3 BA C1 C8 CE D5 DC E2 84 77 DE 70 5B E2 03 8C 00 
39 00 00 00 00 00 02 BD 02 
39 01 00 00 00 00 2B C1 09 0D 11 1B 24 2C 33 3A 42 4A 53 5B 63 6B 73 7B 83 8B 93 9B A4 AC B4 BF C7 D0 DA DE EA F0 F6 FB Fc 00 A4 A5 23 B0 ED 02 38 00
];
	lenovo,lcd-effect-gamma-command-state = "dsi_lp_mode";
};
