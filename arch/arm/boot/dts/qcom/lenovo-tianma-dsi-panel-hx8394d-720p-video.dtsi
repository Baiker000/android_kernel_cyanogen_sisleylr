/* Copyright (c) 2013, The Linux Foundation. All rights reserved.
 *
 * This program is free software; you can redistribute it and/or modify
 * it under the terms of the GNU General Public License version 2 and
 * only version 2 as published by the Free Software Foundation.
 *
 * This program is distributed in the hope that it will be useful,
 * but WITHOUT ANY WARRANTY; without even the implied warranty of
 * MERCHANTABILITY or FITNESS FOR A PARTICULAR PURPOSE.  See the
 * GNU General Public License for more details.
 */

/*---------------------------------------------------------------------------
 * This file is autogenerated file using gcdb parser. Please do not edit it.
 * Update input XML file to add a new entry or update variable in this file
 * VERSION = "1.0"
 *---------------------------------------------------------------------------*/
&mdss_mdp {
	dsi_hx8394d_tianma_720p_video: qcom,mdss_dsi_hx8394d_tianma_720p_video {
		qcom,mdss-dsi-panel-name = "hx8394d 720p video mode dsi panel";
		qcom,mdss-dsi-panel-controller = <&mdss_dsi0>;
		qcom,mdss-dsi-panel-type = "dsi_video_mode";
		qcom,mdss-dsi-panel-destination = "display_1";
		qcom,mdss-dsi-panel-framerate = <60>;
		qcom,mdss-dsi-virtual-channel-id = <0>;
		qcom,mdss-dsi-stream = <0>;
		qcom,mdss-dsi-panel-width = <720>;
		qcom,mdss-dsi-panel-height = <1280>;
		qcom,mdss-dsi-h-front-porch = <144>;
		qcom,mdss-dsi-h-back-porch = <144>;
		qcom,mdss-dsi-h-pulse-width = <48>;
		qcom,mdss-dsi-h-sync-skew = <0>;
		qcom,mdss-dsi-v-back-porch = <12>;
		qcom,mdss-dsi-v-front-porch = <55>;
		qcom,mdss-dsi-v-pulse-width = <4>;
		qcom,mdss-dsi-h-left-border = <0>;
		qcom,mdss-dsi-h-right-border = <0>;
		qcom,mdss-dsi-v-top-border = <0>;
		qcom,mdss-dsi-v-bottom-border = <0>;
		qcom,mdss-dsi-bpp = <24>;
		qcom,mdss-dsi-underflow-color = <0xff>;
		qcom,mdss-dsi-border-color = <0>;
		qcom,mdss-dsi-on-command = [39 01 00 00 00 00 04 B9 FF 83 94
39 01 00 00 00 00 03 BA 33 83
39 01 00 00 00 00 10 B1 7C 0B 11 37 04 11 F1 80 E3 D5 23 80 C0 D2 18
39 01 00 00 00 00 0C B2 00 64 0E 0D 32 23 08 08 1C 4D 00
39 01 00 00 00 00 0D B4 00 FF 03 50 03 50 03 50 01 6A 01 6A
39 01 00 00 00 00 04 BF 41 0E 01
39 01 00 00 00 00 26 D3 00 07 00 00 00 10 00 32 10 05 00 00 32 10 00 00 00 32 10 00 00 00 36 03 09 09 37 00 00 37 00 00 00 00 0A 00 01
39 01 00 00 00 00 2D D5 02 03 00 01 06 07 04 05 20 21 22 23 18 18 18 18 18 18 18 18 18 18 18 18 18 18 18 18 18 18 18 18 18 18 18 18 18 18 24 25 18 18 19 19
39 01 00 00 00 00 2D D6 05 04 07 06 01 00 03 02 23 22 21 20 18 18 18 18 18 18 58 58 18 18 18 18 18 18 18 18 18 18 18 18 18 18 18 18 18 18 25 24 19 19 18 18
39 01 00 00 00 00 2B E0 07 1F 23 38 3B 3F 2E 46 08 0B 0D 17 0F 12 15 13 14 08 12 16 19 07 1F 23 38 3B 3F 2E 46 08 0B 0D 17 0F 12 15 13 14 08 12 16 19
39 01 00 00 00 00 02 BD 00
39 01 00 00 00 00 2C C1 01 00 09 11 19 21 28 2E 34 3C 44 4B 53 5B 63 6B 72 7B 82 89 91 99 A1 A9 B1 B8 C0 C8 D0 D7 DE E7 EE F2 0E E3 55 03 6A E8 48 00 C0
39 01 00 00 00 00 02 BD 01
39 01 00 00 00 00 2B C1 00 09 11 19 20 26 2C 32 39 41 48 50 57 5E 66 6D 76 7D 84 8B 93 9A A1 A9 B2 B8 BE C6 CE D5 DB E3 EA 30 3A A0 77 1D 36 1E 08 C0
39 01 00 00 00 00 02 BD 02
39 01 00 00 00 00 2B C1 00 08 10 18 20 26 2C 33 3A 42 49 52 5A 62 6A 72 7A 82 89 91 98 A1 A9 B2 B9 C0 C8 CF D6 DE E5 EC E7 04 28 BC 00 8C C0 81 88 00
39 01 00 00 00 00 02 CC 09
39 01 00 00 00 00 05 C7 00 C0 40 C0
39 01 00 00 00 00 03 B6 75 75
39 01 00 00 00 00 03 C0 30 14
39 01 00 00 00 00 02 BC 07
39 01 00 00 00 00 02 35 01
39 01 00 00 00 00 0A C9 1F 00 00 1E 81 1E 00 80 44
39 01 00 00 00 00 02 51 00
39 01 00 00 00 00 02 53 24
39 01 00 00 05 00 02 55 03
39 01 00 00 10 00 03 E4 02 00
39 01 00 00 00 00 06 E5 00 04 0B 08 06
39 01 00 00 00 00 02 5E 20
39 01 00 00 00 00 0A CA 37 36 36 36 32 2e 2b 26 22
39 01 00 00 00 00 04 D0 80 40 00
05 01 00 00 78 00 02 11 00
05 01 00 00 00 00 02 29 00];
		qcom,mdss-dsi-off-command = [05 01 00 00 32 00 02 28 00
		     05 01 00 00 32 00 02 10 00];
		qcom,mdss-dsi-on-command-state = "dsi_lp_mode";
		qcom,mdss-dsi-off-command-state = "dsi_hs_mode";
		qcom,mdss-dsi-h-sync-pulse = <1>;
		qcom,mdss-dsi-traffic-mode = "burst_mode";
		qcom,mdss-dsi-lane-map = "lane_map_0123";
		qcom,mdss-dsi-bllp-eof-power-mode;
		qcom,mdss-dsi-bllp-power-mode;
                qcom,mdss-pan-physical-width-dimension = <69>;
                qcom,mdss-pan-physical-height-dimension = <121>;
		qcom,mdss-dsi-lane-0-state;
		qcom,mdss-dsi-lane-1-state;
		qcom,mdss-dsi-lane-2-state;
		qcom,mdss-dsi-lane-3-state;
		qcom,mdss-dsi-panel-timings = [84 20 14 00 46 4A 1A 24 18 03 04 00];
		qcom,mdss-dsi-t-clk-post = <0x04>;
		qcom,mdss-dsi-t-clk-pre = <0x1b>;
		qcom,mdss-dsi-dma-trigger = "trigger_sw";
		qcom,mdss-dsi-mdp-trigger = "none";
		qcom,mdss-dsi-reset-sequence = <1 5>, <0 1>, <1 10>;
		qcom,cont-splash-enabled;
		qcom,esd-check-enabled;
		qcom,mdss-dsi-panel-status-command = [24 01 00 01 05 00 02 0A 00];
		qcom,mdss-dsi-panel-status-command-state = "dsi_lp_mode";
		qcom,mdss-dsi-panel-status-check-mode = "reg_read";
		qcom,mdss-dsi-panel-status-value = <0x1c>;
		qcom,mdss-dsi-lp11-init;
		qcom,mdss-dsi-init-delay-us = <50000>;
	};
};
