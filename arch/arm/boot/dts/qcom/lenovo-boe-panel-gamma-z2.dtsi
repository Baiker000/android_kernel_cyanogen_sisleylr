
&dsi_nt35521_boe_720_vid {

	lenovo,lcd-effect-gamma-command = [
		//L0
		 39 00 00 00 00 00 06 F0 55 AA 52 08 02

		//R(+) MCR cmd
		 39 00 00 00 00 00 11 B0 00 01 00 02 00 2C 00 41 00 54 00 77 00 91 00 D9
		 39 00 00 00 00 00 11 B1 00 FC 01 3C 01 6E 01 C0 02 02 02 04 02 3F 02 82
		 39 00 00 00 00 00 11 B2 02 A7 02 DA 02 FF 03 2B 03 32 03 7C 03 A1 03 A4
		 39 01 00 00 00 00 05 B3 03 AD 03 B6
		//G(+) MCR cmd
		 39 00 00 00 00 00 11 B4 00 F7 00 FB 01 03 01 08 01 0D 01 1D 01 2A 01 43
		 39 00 00 00 00 00 11 B5 01 58 01 84 01 A8 01 E5 02 1B 02 1D 02 52 02 90
		 39 00 00 00 00 00 11 B6 02 B6 02 EB 03 11 03 41 03 49 03 8B 03 AC 03 CB
		 39 00 00 00 00 00 05 B7 03 FA 03 FD
		//B(+) MCR cmd
		 39 00 00 00 00 00 11 B8 01 59 01 5A 01 62 01 66 01 6A 01 71 01 7C 01 89
		 39 00 00 00 00 00 11 B9 01 9A 01 B7 01 D4 02 05 02 34 02 35 02 66 02 A0
		 39 00 00 00 00 00 11 BA 02 C6 02 FF 03 2C 03 97 03 FC 03 FD 03 FD 03 FE
		 39 01 00 00 00 00 05 BB 03 FE 03 FE

		//L1
		 39 00 00 00 00 00 06 F0 55 AA 52 08 02

		//R(+) MCR cmd
		 39 00 00 00 00 00 11 B0 00 01 00 06 00 28 00 3C 00 52 00 74 00 B6 00 DE
		 39 00 00 00 00 00 11 B1 00 FF 01 3E 01 6F 01 C0 02 03 02 05 02 3F 02 82
		 39 00 00 00 00 00 11 B2 02 A8 02 DA 02 FF 03 2B 03 34 03 7D 03 A2 03 A8
		 39 01 00 00 00 00 05 B3 03 AD 03 B6
		//G(+) MCR cmd
		 39 00 00 00 00 00 11 B4 00 E7 00 EA 00 F4 00 FB 01 01 01 0D 01 1D 01 37
		 39 00 00 00 00 00 11 B5 01 4E 01 7C 01 A1 01 E0 02 18 02 19 02 4F 02 8E
		 39 00 00 00 00 00 11 B6 02 B4 02 E9 03 0F 03 3F 03 49 03 8B 03 AC 03 C5
		 39 00 00 00 00 00 05 B7 03 FA 03 FD
		//B(+) MCR cmd
		 39 00 00 00 00 00 11 B8 01 4C 01 4D 01 54 01 59 01 5D 01 69 01 70 01 83
		 39 00 00 00 00 00 11 B9 01 93 01 B1 01 CF 02 00 02 30 02 31 02 63 02 9E
		 39 00 00 00 00 00 11 BA 02 C4 02 FD 03 29 03 89 03 FA 03 FB 03 FC 03 FE
		 39 01 00 00 00 00 05 BB 03 FE 03 FE

		//L2
		 39 00 00 00 00 00 06 F0 55 AA 52 08 02

		//R(+) MCR cmd
		 39 00 00 00 00 00 11 B0 00 02 00 04 00 1F 00 41 00 56 00 77 00 98 00 DC
		 39 00 00 00 00 00 11 B1 00 FE 01 3D 01 70 01 C2 02 02 02 05 02 3E 02 82
		 39 00 00 00 00 00 11 B2 02 A7 02 DA 03 00 03 2D 03 37 03 7F 03 A3 03 A5
		 39 01 00 00 00 00 05 B3 03 AD 03 B6
		//G(+) MCR cmd
		 39 00 00 00 00 00 11 B4 00 D2 00 DC 00 E9 00 EE 00 F7 01 05 01 11 01 2F
		 39 00 00 00 00 00 11 B5 01 47 01 72 01 9A 01 DC 02 16 02 17 02 4D 02 8C
		 39 00 00 00 00 00 11 B6 02 B2 02 E8 03 0D 03 3D 03 49 03 8B 03 AC 03 C6
		 39 00 00 00 00 00 05 B7 03 FA 03 FD
		//B(+) MCR cmd
		 39 00 00 00 00 00 11 B8 01 45 01 46 01 4B 01 52 01 57 01 63 01 6B 01 7E
		 39 00 00 00 00 00 11 B9 01 8C 01 AD 01 CA 01 FD 02 2D 02 2F 02 61 02 9C
		 39 00 00 00 00 00 11 BA 02 C1 02 FB 03 27 03 88 03 FE 03 FE 03 FE 03 FE
		 39 01 00 00 00 00 05 BB 03 FE 03 FE

		//L3
		 39 00 00 00 00 00 06 F0 55 AA 52 08 02

		//R(+) MCR cmd
		 39 00 00 00 00 00 11 B0 00 01 00 02 00 25 00 39 00 56 00 79 00 97 00 D8
		 39 00 00 00 00 00 11 B1 01 00 01 38 01 70 01 C0 02 02 02 05 02 3F 02 81
		 39 00 00 00 00 00 11 B2 02 A8 02 DA 03 00 03 2E 03 3C 03 82 03 A5 03 A9
		 39 01 00 00 00 00 05 B3 03 AD 03 B6
		//G(+) MCR cmd
		 39 00 00 00 00 00 11 B4 00 DF 00 E5 00 ED 00 F5 00 FC 01 09 01 17 01 33
		 39 00 00 00 00 00 11 B5 01 4A 01 79 01 9D 01 DE 02 17 02 18 02 4E 02 8D
		 39 00 00 00 00 00 11 B6 02 B3 02 E8 03 0E 03 3E 03 52 03 90 03 AF 03 C2
		 39 00 00 00 00 00 05 B7 03 FA 03 FD
		//B(+) MCR cmd
		 39 00 00 00 00 00 11 B8 01 29 01 2B 01 32 01 38 01 3E 01 48 01 54 01 6A
		 39 00 00 00 00 00 11 B9 01 7D 01 9E 01 BA 01 F3 02 26 02 27 02 5B 02 97
		 39 00 00 00 00 00 11 BA 02 BD 02 F5 03 20 03 72 03 FE 03 FE 03 FE 03 FE
		 39 01 00 00 00 00 05 BB 03 FE 03 FE

		//L4
		 39 00 00 00 00 00 06 F0 55 AA 52 08 02

		//R(+) MCR cmd
		 39 00 00 00 00 00 11 B0 00 01 00 0A 00 22 00 3B 00 53 00 78 00 A4 00 DD
		 39 00 00 00 00 00 11 B1 00 FF 01 39 01 6D 01 BC 02 03 02 04 02 40 02 82
		 39 00 00 00 00 00 11 B2 02 A7 02 DA 02 FF 03 2D 03 43 03 87 03 A9 03 B8
		 39 01 00 00 00 00 05 B3 03 B9 03 C3
		//G(+) MCR cmd
		 39 00 00 00 00 00 11 B4 00 DD 00 E2 00 EC 00 F4 00 FB 01 08 01 15 01 32
		 39 00 00 00 00 00 11 B5 01 4A 01 74 01 9D 01 DE 02 17 02 19 02 4D 02 8D
		 39 00 00 00 00 00 11 B6 02 B3 02 E8 03 0E 03 3E 03 59 03 95 03 B3 03 B8
		 39 00 00 00 00 00 05 B7 03 E6 03 F5
		//B(+) MCR cmd
		 39 00 00 00 00 00 11 B8 01 0D 01 0E 01 14 01 1C 01 23 01 30 01 3C 01 53
		 39 00 00 00 00 00 11 B9 01 6A 01 8D 01 AF 01 EA 02 20 02 21 02 55 02 93
		 39 00 00 00 00 00 11 BA 02 B8 02 EF 03 19 03 64 03 FE 03 FE 03 FE 03 FE
		 39 01 00 00 00 00 05 BB 03 FE 03 FE

		//L5
		 39 00 00 00 00 00 06 F0 55 AA 52 08 02

		//R(+) MCR cmd
		 39 00 00 00 00 00 11 B0 00 01 00 06 00 0E 00 32 00 41 00 72 00 8C 00 D7
		 39 00 00 00 00 00 11 B1 00 FD 01 37 01 6F 01 BC 02 01 02 04 02 3E 02 81
		 39 00 00 00 00 00 11 B2 02 A8 02 DB 03 00 03 2F 03 46 03 89 03 AA 03 B3
		 39 01 00 00 00 00 05 B3 03 B7 03 B8
		//G(+) MCR cmd
		 39 00 00 00 00 00 11 B4 00 99 00 9B 00 A2 00 C5 00 D5 00 E9 00 F8 01 12
		 39 00 00 00 00 00 11 B5 01 31 01 65 01 8C 01 D3 02 0D 02 0E 02 48 02 88
		 39 00 00 00 00 00 11 B6 02 AE 02 E4 03 09 03 3A 03 59 03 95 03 B3 03 B8
		 39 00 00 00 00 00 05 B7 03 EE 03 F7
		//B(+) MCR cmd
		 39 00 00 00 00 00 11 B8 00 F2 00 F3 00 F9 01 00 01 06 01 12 01 21 01 3B
		 39 00 00 00 00 00 11 B9 01 50 01 7E 01 A2 01 E1 02 19 02 1A 02 4F 02 8D
		 39 00 00 00 00 00 11 BA 02 B4 02 EA 03 15 03 5B 03 E2 03 EC 03 F1 03 FD
		 39 01 00 00 00 00 05 BB 03 FE 03 FE

		//L6
		 39 00 00 00 00 00 06 F0 55 AA 52 08 02

		//R(+) MCR cmd
		 39 00 00 00 00 00 11 B0 00 01 00 02 00 0E 00 36 00 3E 00 69 00 90 00 CC
		 39 00 00 00 00 00 11 B1 00 FA 01 39 01 6D 01 C0 02 02 02 04 02 3E 02 81
		 39 00 00 00 00 00 11 B2 02 A7 02 DA 03 01 03 30 03 4B 03 8C 03 AC 03 AF
		 39 01 00 00 00 00 05 B3 03 B3 03 B6
		//G(+) MCR cmd
		 39 00 00 00 00 00 11 B4 00 90 00 A4 00 A6 00 C2 00 CA 00 E3 00 F3 01 0E
		 39 00 00 00 00 00 11 B5 01 2D 01 5D 01 8A 01 D1 02 0B 02 0D 02 47 02 88
		 39 00 00 00 00 00 11 B6 02 AE 02 E3 03 08 03 39 03 5B 03 96 03 B4 03 B9
		 39 00 00 00 00 00 05 B7 03 F9 03 FA
		//B(+) MCR cmd
		 39 00 00 00 00 00 11 B8 00 E5 00 E6 00 ED 00 F3 00 FA 01 08 01 14 01 31
		 39 00 00 00 00 00 11 B9 01 49 01 79 01 9C 01 DD 02 16 02 18 02 4D 02 8C
		 39 00 00 00 00 00 11 BA 02 B2 02 E8 03 12 03 58 03 FC 03 FD 03 FD 03 FE
		 39 01 00 00 00 00 05 BB 03 FE 03 FE

		//L7
		 39 00 00 00 00 00 06 F0 55 AA 52 08 02

		//R(+) MCR cmd
		 39 00 00 00 00 00 11 B0 00 01 00 02 00 24 00 38 00 4A 00 73 00 8A 00 D2
		 39 00 00 00 00 00 11 B1 00 FA 01 38 01 6F 01 BC 02 01 02 03 02 3F 02 82
		 39 00 00 00 00 00 11 B2 02 A7 02 DC 03 01 03 30 03 4C 03 4F 03 81 03 85
		 39 01 00 00 00 00 05 B3 03 A9 03 B6
		//G(+) MCR cmd
		 39 00 00 00 00 00 11 B4 00 68 00 6F 00 83 00 91 00 AA 00 B4 00 DD 00 FE
		 39 00 00 00 00 00 11 B5 01 1B 01 53 01 81 01 CA 02 08 02 09 02 43 02 85
		 39 00 00 00 00 00 11 B6 02 AB 02 E1 03 06 03 37 03 59 03 5B 03 89 03 F7
		 39 00 00 00 00 00 05 B7 03 FA 03 FD
		//B(+) MCR cmd
		 39 00 00 00 00 00 11 B8 00 C5 00 C7 00 D5 00 E0 00 E9 00 F7 01 05 01 20
		 39 00 00 00 00 00 11 B9 01 3B 01 6B 01 93 01 D7 02 0F 02 13 02 49 02 89
		 39 00 00 00 00 00 11 BA 02 AF 02 E7 03 0F 03 53 03 CB 03 FE 03 FE 03 FE
		 39 01 00 00 00 00 05 BB 03 FE 03 FE

		//L8
		 39 00 00 00 00 00 06 F0 55 AA 52 08 02

		//R(+) MCR cmd
		 39 00 00 00 00 00 11 B0 00 01 00 03 00 12 00 36 00 46 00 6D 00 8E 00 D2
		 39 00 00 00 00 00 11 B1 00 FA 01 38 01 6F 01 C1 02 02 02 04 02 3F 02 81
		 39 00 00 00 00 00 11 B2 02 A8 02 DB 03 00 03 2F 03 4C 03 4F 03 81 03 85
		 39 01 00 00 00 00 05 B3 03 AD 03 B6
		//G(+) MCR cmd
		 39 00 00 00 00 00 11 B4 00 84 00 8A 00 A9 00 AF 00 B4 00 D6 00 ED 01 0A
		 39 00 00 00 00 00 11 B5 01 26 01 5A 01 87 01 CF 02 0A 02 0C 02 46 02 87
		 39 00 00 00 00 00 11 B6 02 AD 02 E3 03 08 03 39 03 5B 03 62 03 8E 03 F9
		 39 00 00 00 00 00 05 B7 03 FA 03 FD
		//B(+) MCR cmd
		 39 00 00 00 00 00 11 B8 00 A5 00 A6 00 B3 00 CD 00 D2 00 EB 00 F9 01 13
		 39 00 00 00 00 00 11 B9 01 31 01 65 01 8C 01 D4 02 0C 02 0E 02 47 02 87
		 39 00 00 00 00 00 11 BA 02 AD 02 E4 03 0C 03 4D 03 A0 03 F1 03 F5 03 FE
		 39 01 00 00 00 00 05 BB 03 FE 03 FE

		//L9
		 39 00 00 00 00 00 06 F0 55 AA 52 08 02

		//R(+) MCR cmd
		 39 00 00 00 00 00 11 B0 00 02 00 06 00 0E 00 36 00 49 00 6D 00 90 00 DD
		 39 00 00 00 00 00 11 B1 00 FA 01 3A 01 6F 01 BE 02 02 02 03 02 3E 02 81
		 39 00 00 00 00 00 11 B2 02 A7 02 DD 03 01 03 2F 03 4D 03 56 03 86 03 89
		 39 01 00 00 00 00 05 B3 03 A9 03 B6
		//G(+) MCR cmd
		 39 00 00 00 00 00 11 B4 00 73 00 7A 00 8C 00 99 00 A0 00 CC 00 E6 01 04
		 39 00 00 00 00 00 11 B5 01 1F 01 51 01 84 01 CD 02 09 02 0A 02 45 02 86
		 39 00 00 00 00 00 11 B6 02 AC 02 E1 03 07 03 38 03 5A 03 64 03 90 03 E2
		 39 00 00 00 00 00 05 B7 03 FA 03 FD
		//B(+) MCR cmd
		 39 00 00 00 00 00 11 B8 00 83 00 87 00 93 00 AB 00 C1 00 D4 00 E8 01 05
		 39 00 00 00 00 00 11 B9 01 21 01 51 01 84 01 CC 02 09 02 0A 02 43 02 85
		 39 00 00 00 00 00 11 BA 02 AA 02 E1 03 09 03 46 03 91 03 FD 03 FD 03 FE
		 39 01 00 00 00 00 05 BB 03 FE 03 FE

		//L10
		 39 00 00 00 00 00 06 F0 55 AA 52 08 02

		//R(+) MCR cmd
		 39 00 00 00 00 00 11 B0 00 02 00 04 00 1F 00 34 00 49 00 67 00 8D 00 D2
		 39 00 00 00 00 00 11 B1 00 FD 01 3A 01 6D 01 C0 02 03 02 06 02 40 02 81
		 39 00 00 00 00 00 11 B2 02 A8 02 DD 03 00 03 30 03 4C 03 5D 03 8B 03 8C
		 39 01 00 00 00 00 05 B3 03 A9 03 B6
		//G(+) MCR cmd
		 39 00 00 00 00 00 11 B4 00 6E 00 75 00 88 00 97 00 BF 00 C7 00 E3 01 02
		 39 00 00 00 00 00 11 B5 01 1E 01 55 01 84 01 CC 02 08 02 09 02 44 02 86
		 39 00 00 00 00 00 11 B6 02 AB 02 E1 03 07 03 38 03 5B 03 6D 03 96 03 F5
		 39 00 00 00 00 00 05 B7 03 FA 03 FD
		//B(+) MCR cmd
		 39 00 00 00 00 00 11 B8 00 39 00 3D 00 52 00 64 00 72 00 8E 00 B1 00 E7
		 39 00 00 00 00 00 11 B9 01 06 01 3F 01 70 01 C0 02 01 02 03 02 3D 02 7F
		 39 00 00 00 00 00 11 BA 02 A6 02 DC 03 04 03 3E 03 7C 03 F1 03 F5 03 FC
		 39 01 00 00 00 00 05 BB 03 FD 03 FE

		//L11
		 39 00 00 00 00 00 06 F0 55 AA 52 08 02

		//R(+) MCR cmd
		 39 00 00 00 00 00 11 B0 00 01 00 02 00 2A 00 41 00 57 00 79 00 89 00 E2
		 39 00 00 00 00 00 11 B1 00 FF 01 3D 01 70 01 C2 02 03 02 04 02 3F 02 82
		 39 00 00 00 00 00 11 B2 02 A8 02 DD 03 03 03 32 03 51 03 62 03 8E 03 91
		 39 01 00 00 00 00 05 B3 03 A9 03 B6
		//G(+) MCR cmd
		 39 00 00 00 00 00 11 B4 00 49 00 54 00 68 00 77 00 86 00 9D 00 BD 00 F3
		 39 00 00 00 00 00 11 B5 01 0F 01 49 01 7B 01 C7 02 05 02 07 02 41 02 83
		 39 00 00 00 00 00 11 B6 02 A9 02 DF 03 05 03 36 03 58 03 6D 03 96 03 DA
		 39 00 00 00 00 00 05 B7 03 FA 03 FD
		//B(+) MCR cmd
		 39 00 00 00 00 00 11 B8 00 01 00 05 00 22 00 3B 00 51 00 72 00 90 00 D4
		 39 00 00 00 00 00 11 B9 00 F7 01 34 01 6A 01 B8 01 FC 01 FE 02 3A 02 7D
		 39 00 00 00 00 00 11 BA 02 A4 02 DA 03 02 03 3C 03 79 03 FE 03 FE 03 FE
		 39 01 00 00 00 00 05 BB 03 FE 03 FE

		//L12
		 39 00 00 00 00 00 06 F0 55 AA 52 08 02

		//R(+) MCR cmd
		 39 00 00 00 00 00 11 B0 00 25 00 35 00 44 00 54 00 6B 00 8C 00 B2 00 EE
		 39 00 00 00 00 00 11 B1 01 09 01 46 01 74 01 C5 02 07 02 08 02 42 02 85
		 39 00 00 00 00 00 11 B2 02 AA 02 DE 03 02 03 31 03 4D 03 64 03 90 03 91
		 39 01 00 00 00 00 05 B3 03 A9 03 B6
		//G(+) MCR cmd
		 39 00 00 00 00 00 11 B4 00 A1 00 A2 00 C5 00 D5 00 E0 00 F0 01 01 01 1C
		 39 00 00 00 00 00 11 B5 01 38 01 69 01 91 01 D7 02 0E 02 10 02 49 02 89
		 39 00 00 00 00 00 11 B6 02 AF 02 E5 03 0B 03 3C 03 5F 03 7B 03 A0 03 E9
		 39 00 00 00 00 00 05 B7 03 FA 03 FD
		//B(+) MCR cmd
		 39 00 00 00 00 00 11 B8 00 02 00 03 00 1C 00 37 00 4E 00 6F 00 8C 00 CC
		 39 00 00 00 00 00 11 B9 00 F7 01 33 01 69 01 B8 01 F9 01 FF 02 3A 02 7D
		 39 00 00 00 00 00 11 BA 02 A4 02 D9 03 00 03 39 03 6F 03 FA 03 FB 03 FC
		 39 01 00 00 00 00 05 BB 03 FD 03 FE

		//L13
		 39 00 00 00 00 00 06 F0 55 AA 52 08 02

		//R(+) MCR cmd
		39 00 00 00 00 00 11 B0 00 82 00 92 00 97 00 C1 00 C4 00 E2 00 EF 01 0C
		39 00 00 00 00 00 11 B1 01 2E 01 5D 01 8C 01 D4 02 0D 02 11 02 4A 02 89
		39 00 00 00 00 00 11 B2 02 AF 02 E6 03 09 03 38 03 59 03 6B 03 95 03 99
		39 01 00 00 00 00 05 B3 03 AD 03 B6
		//G(+) MCR cmd
		39 00 00 00 00 00 11 B4 00 7C 00 80 00 92 00 A9 00 AF 00 CC 00 E7 01 06
		39 00 00 00 00 00 11 B5 01 22 01 57 01 85 01 CE 02 09 02 0A 02 45 02 86
		39 00 00 00 00 00 11 B6 02 AC 02 E2 03 07 03 38 03 5A 03 74 03 9B 03 C8
		39 00 00 00 00 00 05 B7 03 FA 03 FD
		//B(+) MCR cmd
		39 00 00 00 00 00 11 B8 00 02 00 03 00 1D 00 37 00 4B 00 6E 00 8C 00 CC
		39 00 00 00 00 00 11 B9 00 F7 01 33 01 69 01 B8 01 FB 01 FE 02 3A 02 7D
		39 00 00 00 00 00 11 BA 02 A4 02 D9 03 01 03 39 03 72 03 FE 03 FE 03 FE
		39 01 00 00 00 00 05 BB 03 FE 03 FE

		//L14
		 39 00 00 00 00 00 06 F0 55 AA 52 08 02

		//R(+) MCR cmd
		 39 00 00 00 00 00 11 B0 00 A8 00 AF 00 C2 00 C9 00 CE 00 EB 00 F9 01 18
		 39 00 00 00 00 00 11 B1 01 38 01 6A 01 91 01 D8 02 14 02 16 02 4B 02 8A
		 39 00 00 00 00 00 11 B2 02 B2 02 E7 03 0B 03 3A 03 59 03 71 03 99 03 9B
		 39 01 00 00 00 00 05 B3 03 AD 03 B6
		//G(+) MCR cmd
		 39 00 00 00 00 00 11 B4 00 93 00 A4 00 BE 00 C2 00 C5 00 E1 00 F1 01 0D
		 39 00 00 00 00 00 11 B5 01 2D 01 5D 01 8A 01 D2 02 0B 02 0D 02 47 02 88
		 39 00 00 00 00 00 11 B6 02 AD 02 E3 03 08 03 39 03 5C 03 76 03 9D 03 C9
		 39 00 00 00 00 00 05 B7 03 FA 03 FD
		//B(+) MCR cmd
		 39 00 00 00 00 00 11 B8 00 02 00 03 00 1D 00 38 00 4C 00 6F 00 8B 00 CC
		 39 00 00 00 00 00 11 B9 00 F7 01 33 01 69 01 B8 01 F9 01 FE 02 3A 02 7D
		 39 00 00 00 00 00 11 BA 02 A4 02 D9 03 00 03 39 03 6F 03 F1 03 F5 03 FD
		 39 01 00 00 00 00 05 BB 03 FE 03 FE

		//L15
		 39 00 00 00 00 00 06 F0 55 AA 52 08 02

		//R(+) MCR cmd
		 39 00 00 00 00 00 11 B0 00 C3 00 D4 00 E2 00 E3 00 E8 00 FA 01 0A 01 2A
		 39 00 00 00 00 00 11 B1 01 42 01 6F 01 9A 01 DC 02 16 02 19 02 4D 02 8D
		 39 00 00 00 00 00 11 B2 02 B3 02 E8 03 0B 03 3A 03 5A 03 74 03 9B 03 9D
		 39 01 00 00 00 00 05 B3 03 AD 03 B6
		//G(+) MCR cmd
		 39 00 00 00 00 00 11 B4 00 9E 00 BC 00 C2 00 CC 00 D6 00 EC 00 FC 01 19
		 39 00 00 00 00 00 11 B5 01 36 01 68 01 8F 01 D6 02 0E 02 0F 02 49 02 89
		 39 00 00 00 00 00 11 B6 02 AF 02 E5 03 0A 03 3B 03 5D 03 7B 03 A0 03 C8
		 39 00 00 00 00 00 05 B7 03 FA 03 FD
		//B(+) MCR cmd
		 39 00 00 00 00 00 11 B8 00 02 00 03 00 21 00 37 00 4E 00 6F 00 8E 00 CC
		 39 00 00 00 00 00 11 B9 00 F7 01 34 01 69 01 B8 01 FC 01 FE 02 3A 02 7D
		 39 00 00 00 00 00 11 BA 02 A4 02 D9 03 00 03 38 03 6C 03 FA 03 FB 03 FE
		 39 01 00 00 00 00 05 BB 03 FE 03 FE];
	lenovo,lcd-effect-gamma-command-state = "dsi_lp_mode";
};
