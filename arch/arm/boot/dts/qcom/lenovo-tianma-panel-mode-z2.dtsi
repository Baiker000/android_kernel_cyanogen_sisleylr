

&dsi_hx8394d_tianma_720p_video  {

	lenovo,lcd-effect-custom-mode-command = [
39 01 00 00 05 00 02 55 03
39 01 00 00 00 00 0A CA 37 36 36 36 32 2e 2b 26 22

39 01 00 00 00 00 02 BD 00
39 01 00 00 00 00 2C C1 01 09 13 15 1A 21 28 2E 34 3C 44 4B 53 5B 63 6B 72 7B 82 89 91 99 A1 A9 B1 B8 C0 C8 D0 D7 DE E7 EE F2 0E E3 55 03 6A E8 48 00 C0
39 01 00 00 00 00 02 BD 01
39 01 00 00 00 00 2B C1 00 09 13 19 20 26 2C 32 39 41 48 50 57 5E 66 6D 76 7D 84 8B 93 9A A1 A9 B2 B8 BE C6 CE D5 DB E3 EA 30 3A A0 77 1D 36 1E 08 C0 
39 01 00 00 00 00 02 BD 02
39 01 00 00 00 00 2B C1 00 00 10 18 1F 26 2C 33 3A 42 49 52 5A 62 6A 72 7A 82 89 91 98 A1 A9 B2 B9 C0 C8 CF D6 DE E5 EC E7 04 28 BC 00 8C C0 81 88 00
 
39 01 00 00 05 00 03 E4 00 00
39 01 00 00 00 00 04 D0 80 40 00];
	lenovo,lcd-effect-custom-mode-command-state = "dsi_lp_mode";

	lenovo,lcd-effect-default-mode-command = [
39 01 00 00 05 00 02 55 03
39 01 00 00 00 00 0A CA 37 36 36 36 32 2e 2b 26 22

39 01 00 00 00 00 02 BD 00
39 01 00 00 00 00 2C C1 01 00 09 11 19 21 28 2E 34 3C 44 4B 53 5B 63 6B 72 7B 82 89 91 99 A1 A9 B1 B8 C0 C8 D0 D7 DE E7 EE F2 0E E3 55 03 6A E8 48 00 C0
39 01 00 00 00 00 02 BD 01
39 01 00 00 00 00 2B C1 00 09 11 19 20 26 2C 32 39 41 48 50 57 5E 66 6D 76 7D 84 8B 93 9A A1 A9 B2 B8 BE C6 CE D5 DB E3 EA 30 3A A0 77 1D 36 1E 08 C0
39 01 00 00 00 00 02 BD 02
39 01 00 00 00 00 2B C1 00 08 10 18 20 26 2C 33 3A 42 49 52 5A 62 6A 72 7A 82 89 91 98 A1 A9 B2 B9 C0 C8 CF D6 DE E5 EC E7 04 28 BC 00 8C C0 81 88 00

39 01 00 00 05 00 03 E4 02 00
39 01 00 00 00 00 07 E5 00 00 04 0B 08 06
39 01 00 00 00 00 04 D0 80 40 00];
	lenovo,lcd-effect-default-mode-command-state = "dsi_lp_mode";


	lenovo,lcd-effect-comfort-mode-command = [
39 01 00 00 05 00 02 55 03
39 01 00 00 00 00 0A CA 37 36 36 36 32 2e 2b 26 22

39 01 00 00 00 00 02 BD 00
39 01 00 00 00 00 2C C1 01 1C 1C 1E 21 26 2A 2F 35 3D 44 4C 54 5D 66 6E 76 7E 86 8E 97 9F A8 B1 B9 C1 CA D2 DA E2 EA F3 F9 FF E8 BC C9 42 6A BB 01 CB 00
39 01 00 00 00 00 02 BD 01
39 01 00 00 00 00 2B C1 1C 1C 1E 21 25 2A 2E 33 3A 41 48 4F 57 5F 66 6E 75 7C 83 8A 92 99 A1 A9 B1 B7 BE C5 CD D4 DA E2 E8 E8 72 46 35 ED 1C 03 70 00
39 01 00 00 00 00 02 BD 02
39 01 00 00 00 00 2B C1 1C 1C 1E 20 24 27 2B 2F 33 39 3F 44 4A 50 57 5D 63 69 6F 75 7B 80 86 8C 92 98 9E A4 AA B0 B6 BB C0 88 A8 C6 49 5B 1D 00 49 00 

39 01 00 00 05 00 03 E4 02 00
39 01 00 00 00 00 07 E5 00 00 04 0B 08 06
39 01 00 00 00 00 04 D0 80 40 00];
	lenovo,lcd-effect-comfort-mode-command-state = "dsi_lp_mode";



	lenovo,lcd-effect-outside-mode-command = [
39 01 00 00 05 00 02 55 03
39 01 00 00 00 00 0A CA 37 36 36 36 32 2e 2b 26 22

39 01 00 00 00 00 02 BD 00 
39 01 00 00 00 00 2C C1 01 09 13 15 1A 21 28 2E 34 3C 44 4B 53 5B 63 6B 72 7B 82 89 91 99 A1 A9 B1 B8 C0 C8 D0 D7 DE E7 EE F2 0E E3 55 03 6A E8 48 00 C0
39 01 00 00 00 00 02 BD 01 
39 01 00 00 00 00 2B C1 00 09 13 19 20 26 2C 32 39 41 48 50 57 5E 66 6D 76 7D 84 8B 93 9A A1 A9 B2 B8 BE C6 CE D5 DB E3 EA 30 3A A0 77 1D 36 1E 08 C0 
39 01 00 00 00 00 02 BD 02 
39 01 00 00 00 00 2B C1 00 00 10 18 1F 26 2C 33 3A 42 49 52 5A 62 6A 72 7A 82 89 91 98 A1 A9 B2 B9 C0 C8 CF D6 DE E5 EC E7 04 28 BC 00 8C C0 81 88 00 

39 01 00 00 05 00 03 E4 02 00
39 01 00 00 00 00 07 E5 00 00 04 0B 08 06
39 01 00 00 00 00 04 D0 80 40 01];
	lenovo,lcd-effect-outside-mode-command-state = "dsi_lp_mode";

	lenovo,lcd-effect-ultra-mode-command = [
39 01 00 00 05 00 02 55 03
39 01 00 00 00 00 0A CA 37 36 36 36 32 2e 2b 26 22

39 01 00 00 00 00 02 BD 00
39 01 00 00 00 00 2C C1 01 09 13 15 1A 21 28 2E 34 3C 44 4B 53 5B 63 6B 72 7B 82 89 91 99 A1 A9 B1 B8 C0 C8 D0 D7 DE E7 EE F2 0E E3 55 03 6A E8 48 00 C0
39 01 00 00 00 00 02 BD 01
39 01 00 00 00 00 2B C1 00 09 13 19 20 26 2C 32 39 41 48 50 57 5E 66 6D 76 7D 84 8B 93 9A A1 A9 B2 B8 BE C6 CE D5 DB E3 EA 30 3A A0 77 1D 36 1E 08 C0 
39 01 00 00 00 00 02 BD 02
39 01 00 00 00 00 2B C1 00 00 10 18 1F 26 2C 33 3A 42 49 52 5A 62 6A 72 7A 82 89 91 98 A1 A9 B2 B9 C0 C8 CF D6 DE E5 EC E7 04 28 BC 00 8C C0 81 88 00 

39 01 00 00 05 00 03 E4 02 00
39 01 00 00 00 00 07 E5 00 00 04 0B 08 06
39 01 00 00 00 00 04 D0 80 40 00];
	lenovo,lcd-effect-ultra-mode-command-state = "dsi_lp_mode";

	lenovo,lcd-effect-camera-mode-command = [
39 01 00 00 05 00 02 55 00

39 01 00 00 00 00 02 BD 00
39 01 00 00 00 00 2C C1 01 09 13 15 1A 21 28 2E 34 3C 44 4B 53 5B 63 6B 72 7B 82 89 91 99 A1 A9 B1 B8 C0 C8 D0 D7 DE E7 EE F2 0E E3 55 03 6A E8 48 00 C0
39 01 00 00 00 00 02 BD 01
39 01 00 00 00 00 2B C1 00 09 13 19 20 26 2C 32 39 41 48 50 57 5E 66 6D 76 7D 84 8B 93 9A A1 A9 B2 B8 BE C6 CE D5 DB E3 EA 30 3A A0 77 1D 36 1E 08 C0 
39 01 00 00 00 00 02 BD 02
39 01 00 00 00 00 2B C1 00 00 10 18 1F 26 2C 33 3A 42 49 52 5A 62 6A 72 7A 82 89 91 98 A1 A9 B2 B9 C0 C8 CF D6 DE E5 EC E7 04 28 BC 00 8C C0 81 88 00 

39 01 00 00 05 00 03 E4 00 00
39 01 00 00 00 00 04 D0 80 40 00
];
	lenovo,lcd-effect-camera-mode-command-state = "dsi_lp_mode";

};

